#ifndef _UART_H_
#define _UART_H_

unsigned char HexTable[]={'0','1','2','3','4','5','6','7','8','9','A','B','C','D','E','F'};
/*******************************************************************************
****函数功能:初始化UART接口
****入口参数:
****出口参数:
****函数备注:
*******************************************************************************/
void uart_init(void)
{
  UART2_CR1=0x00;//1个起始位，8个数据位，无校验位
  UART2_CR2=0x2c;//接收中断使能，使能发送、接收
  UART2_CR3=0x00;//1个停止位
  //设置波特率 9600
  UART2_BRR2=0x00;
  UART2_BRR1=0x0d;
}
/*******************************************************************************
****函数功能:UART2接收数据函数
****入口参数:
****出口参数:
****函数备注:
*******************************************************************************/
unsigned char uart_receivedata8(void)
{
  while((UART2_SR&0x20)==0);
  return ((unsigned char)UART2_DR);
}
/*******************************************************************************
****函数功能:UART2发送数据函数
****入口参数:
****出口参数:
****函数备注:
*******************************************************************************/
void uart_senddata8(unsigned char Data)
{
   while((UART2_SR&0x80)==0);
   UART2_DR = Data;
}
/*******************************************************************************
****函数功能:UART2发送十六进制数据函数
****入口参数:
****出口参数:
****函数备注:
*******************************************************************************/
void uart_sendhex(unsigned char dat)
{
   uart_senddata8('0');
   uart_senddata8('x');
   uart_senddata8(HexTable[dat>>4]);
   uart_senddata8(HexTable[dat&0x0f]);
   uart_senddata8(' ');
}
/*******************************************************************************
****函数功能:UART2发送字符串函数
****入口参数:
****出口参数:
****函数备注:
*******************************************************************************/
void uart_sendstr(unsigned char *dat)
{
    while(*dat!='\0')	
    {			
      uart_senddata8(*dat);			
      dat++;	
    }
}

/*******************************************************************************
****函数功能:UART2接收中断函数
****入口参数:
****出口参数:
****函数备注:
*******************************************************************************/
#pragma vector=UART2_R_RXNE_vector  //定义中断服务函数入口地址
__interrupt void UART2_R_RXNE__IRQHandler(void)
{
   uart_senddata8(uart_receivedata8());
}

#endif
